## conf/distro/poky-sirius.conf
```bitbake
# Distro for sirius image based on poky

require conf/distro/poky.conf
DISTRO = "poky-sirius"
DISTRO_VERSION = "1.0+snapshot-${DATE}"
DISTRO_CODENAME = "next gen distro"
MAINTAINER = "Prashant <diwateprashant@gmail.com>"

POKY_DEFAULT_EXTRA_RDEPENDS = ""
POKY_DEFAULT_EXTRA_RRECOMMENDS = ""

#DISTRO_FEATURES = "${DISTRO_FEATURES_LIBC_DEFAULT} largefile sysvinit xattr bluetooth"

DISTRO_FEATURES_append = " systemd"
DISTRO_FEATURES_BACKFILL_CONSIDERED += "sysvinit"
VIRTUAL-RUNTIME_init_manager = "systemd"
VIRTUAL-RUNTIME_initscripts = "systemd-compat-units"

PACKAGE_CLASSES = "package_deb"

# Source Mirrors
PREMIRRORS ??= "\
bzr://.*/.*   http://downloads.yoctoproject.org/mirror/sources/ \n \
cvs://.*/.*   http://downloads.yoctoproject.org/mirror/sources/ \n \
git://.*/.*   http://downloads.yoctoproject.org/mirror/sources/ \n \
gitsm://.*/.* http://downloads.yoctoproject.org/mirror/sources/ \n \
hg://.*/.*    http://downloads.yoctoproject.org/mirror/sources/ \n \
osc://.*/.*   http://downloads.yoctoproject.org/mirror/sources/ \n \
p4://.*/.*    http://downloads.yoctoproject.org/mirror/sources/ \n \
svk://.*/.*   http://downloads.yoctoproject.org/mirror/sources/ \n \
svn://.*/.*   http://downloads.yoctoproject.org/mirror/sources/ \n"

MIRRORS =+ "\
ftp://.*/.*      http://downloads.yoctoproject.org/mirror/sources/ \n \
http://.*/.*     http://downloads.yoctoproject.org/mirror/sources/ \n \
https://.*/.*    http://downloads.yoctoproject.org/mirror/sources/ \n"

ROOT_HOME = "/root"
```

## conf/distro/sirius.conf
```bitbake
# Distro for Sirius images based on Poky

require conf/distro/poky.conf

DISTRO = "sirius"
DISTRO_NAME = "Sirius Embedded Linux"
DISTRO_VERSION = "1.0+snapshot-${DATE}"
DISTRO_CODENAME = "sirius"
MAINTAINER = "Prashant Divate <diwateprashant@gmail.com>"

POKY_DEFAULT_EXTRA_RDEPENDS = ""
POKY_DEFAULT_EXTRA_RRECOMMENDS = ""

# Optional meta-sirius features
SIRIUS_ENABLE_SHELLHUB ?= "0"

# Use systemd as default init manager
DISTRO_FEATURES:append = " systemd"
DISTRO_FEATURES_BACKFILL_CONSIDERED += "sysvinit"
VIRTUAL-RUNTIME_init_manager = "systemd"
VIRTUAL-RUNTIME_initscripts = "systemd-compat-units"

PACKAGE_CLASSES ?= "package_ipk"

ROOT_HOME = "/root"

# Avoid pulseaudio backfill unless explicitly needed
DISTRO_FEATURES_BACKFILL_CONSIDERED += " pulseaudio"
```

## conf/layer.conf
```bitbake
# We have a conf and classes directory, add to BBPATH
BBPATH .= ":${LAYERDIR}"

# We have recipes-* directories, add to BBFILES
BBFILES += "${LAYERDIR}/recipes-*/*/*.bb \
            ${LAYERDIR}/recipes-*/*/*.bbappend"

BBFILE_COLLECTIONS += "meta-sirius"
BBFILE_PATTERN_meta-sirius = "^${LAYERDIR}/"
BBFILE_PRIORITY_meta-sirius = "6"

LAYERSERIES_COMPAT_meta-sirius = "sumo thud warrior zeus dunfell"
```

## conf/machine/commboard.conf
```bitbake
#@TYPE: Machine
#@NAME: variscite-imx6ul
#@DESCRIPTION: variscite-imx6ul


# variscite DART-6ul Eval kit SOM conf file
include conf/machine/imx6ul-var-dart.conf

MACHINE_FEATURES:remove = "rtc"
MACHINE_FEATURES_BACKFILL_CONSIDERED += "rtc"
```

## wic/sd-card.wks
```
# short-description: Create a generic root filesystem disk image
# long-description: Create a generic partitioned image that contains the root filesystem.
#
# This WIC layout intentionally avoids board-specific bootloader offsets,
# bootloader blobs, and SoC-specific storage names. BSP layers can provide
# their own WKS files when a platform needs a custom boot layout.

part / --source rootfs --ondisk sda --fstype=ext4 --label root --align 4096

bootloader --ptable msdos
```
